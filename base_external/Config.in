## base_external/Config.in
```kconfig
source "$BR2_EXTERNAL_BAR_42_PATH/package/aesd-assignments/Config.in"
source "$BR2_EXTERNAL_BAR_42_PATH/package/scull/Config.in"
source "$BR2_EXTERNAL_BAR_42_PATH/package/misc-modules/Config.in"
source "$BR2_EXTERNAL_BAR_42_PATH/package/ldd/Config.in"
```

## base_external/package/aesd-assignments/Config.in
```kconfig
config BR2_PACKAGE_AESD_ASSIGNMENTS
	bool "aesd-assignments"
	help
	  Includes the writer executable, finder.sh and tester.sh in the kernel image.
	  Used to understand buildroot external trees and package builds.

config BR2_WGET
	string "Wget command"
	default "wget -nd -t 3"
```

## base_external/package/ldd/Config.in
```kconfig
config BR2_PACKAGE_LDD
	bool "ldd"
	help
	  Package for startup scripts for the kernel module
```
